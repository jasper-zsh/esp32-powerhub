## sdkconfig.defaults
```kconfig
# Enable Bluetooth and NimBLE
CONFIG_BT_ENABLED=y
CONFIG_BT_NIMBLE_ENABLED=y
CONFIG_BT_BLUEDROID_ENABLED=n

# Target: ESP32C6
CONFIG_IDF_TARGET_ESP32C6=y

# NimBLE GAP device name max length
CONFIG_BT_NIMBLE_SVC_GAP_DEVICE_NAME_MAX_LEN=24

# ULP not used - using LightSleep instead for ESP32C6
# ESP32C6 cannot read ADC in ULP mode, using LightSleep with timer wakeup

# Dual Console Output Configuration
# Primary: UART0, Secondary: USB Serial/JTAG
CONFIG_ESP_CONSOLE_UART_DEFAULT=y
CONFIG_ESP_CONSOLE_SECONDARY_USB_SERIAL_JTAG=y

# UART Configuration for primary output
CONFIG_ESP_CONSOLE_UART_NUM=0
CONFIG_ESP_CONSOLE_UART_BAUDRATE=115200

# USB Serial JTAG configuration for secondary output
CONFIG_ESP_CONSOLE_USB_SERIAL_JTAG_ENABLED=y
```
